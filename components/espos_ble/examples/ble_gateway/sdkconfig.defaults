## components/espos_config/Kconfig
```kconfig
menu "espOS config store"

    config ESPOS_CONFIG_NVS_PARTITION
        string "NVS partition label"
        default "nvs"
        help
            Label of the NVS partition holding the configuration store.

    config ESPOS_CONFIG_MAX_MIGRATIONS
        int "Maximum registered migration steps"
        default 16
        range 1 128

    config ESPOS_CONFIG_MAX_SUBSCRIBERS
        int "Maximum change subscribers"
        default 8
        range 1 32

    config ESPOS_CONFIG_MAX_RUNTIME_NS
        int "Maximum runtime-registered namespaces"
        default 32
        range 0 128
        help
            Slots for namespaces registered at run time with
            espos_config_register_ns() — one per graph node that owns
            settings. Each costs one pointer plus an open NVS handle; the
            limit exists so the table is fixed-size like every other in
            espOS. Registration past this fails loudly (health condition
            flowConfig), it never silently drops a node's settings.

endmenu
```

## components/espos_flow/Kconfig
```kconfig
menu "espOS flow"

    config ESPOS_FLOW_TASK_STACK
        int "Flow loop task stack (bytes)"
        default 6144
        range 2048 32768
        help
            Every node in every graph runs on this one stack: a Poll's read
            function, a Lambda's arithmetic, a Sink's publish, all nested as
            deep as the longest chain. 6 KB carries the built-in nodes and a
            reasonable application with room to spare; raise it if your own
            transform uses a large local buffer, and remember that a chain is
            call depth, not iteration — ten nodes in a row are ten frames.

            Comes from internal RAM like every task stack, which on a board
            with PSRAM is the scarce pool.

    config ESPOS_FLOW_TASK_PRIO
        int "Flow loop task priority"
        default 5
        range 1 24
        help
            Above the idle and housekeeping tasks and below the WiFi/network
            stack (tskIDLE_PRIORITY+18 on IDF), so a busy graph never starves
            the radio and a busy radio only delays the graph. Raise it only if
            a timer's jitter genuinely matters more than the network's.

    config ESPOS_FLOW_MAILBOX_DEPTH
        int "Flow mailbox depth (messages)"
        default 32
        range 4 256
        help
            How many pieces of work other tasks and interrupts may have queued
            for the flow loop at once (8 bytes each, reserved for the life of
            the firmware). Posting never blocks: past this depth a post is
            dropped and counted, and health condition "flowMailbox" is raised
            as a WARNING once.

            Deep enough that a burst of interrupts does not lose data, shallow
            enough that a permanently overloaded loop is visible rather than
            silently latent. If drops appear, the fix is usually a slower
            producer or a faster consumer, not a bigger queue.

    config ESPOS_FLOW_MAX_TIMERS
        int "Timer slots"
        default 32
        range 4 256
        help
            Slots for espos_flow_every()/after() and every Poll and Ticker node
            (~24 bytes each, reserved for the life of the firmware). Exhaustion
            is ESP_ERR_NO_MEM and a loud log line at wiring time, never a
            silently dropped timer.

    config ESPOS_FLOW_MAX_EDGES
        int "Graph edges"
        default 96
        range 8 1024
        help
            The static pool every connect_to() takes an edge from (~12 bytes
            each). One edge per connection, so a chain of five nodes is four
            edges and a producer feeding three consumers is three.

            Exhaustion aborts at wiring time with the node ids involved rather
            than dropping the connection: a graph that silently lost an edge
            would look like a sensor that stopped working months later.

    config ESPOS_FLOW_CHECK_TASK
        bool "Assert that emit() runs on the flow task"
        default y
        help
            The whole no-locks-in-nodes argument rests on one rule: everything
            in a graph runs on the flow task, and anything else comes in
            through a Mailbox. With this on, an emit() from the wrong task
            fails immediately, naming the task, instead of corrupting a node's
            state in a way that surfaces as an impossible value next season.

            Costs one task-handle comparison per emit. Leave it on unless a
            profile says otherwise; the class of bug it catches is the
            expensive one.

    config ESPOS_FLOW_HEALTH
        bool "Report flow conditions to espos_health"
        default y
        help
            Raises "flowMailbox" (WARN) the first time a post is dropped, so a
            loop that cannot keep up shows on the health page and in SignalK
            notifications instead of only in the counters. Turn off for a
            firmware that does not build espos_health.

endmenu
```

## components/espos_health/Kconfig
```kconfig
menu "espOS health"

    config ESPOS_HEALTH_MAX_CONDITIONS
        int "Distinct condition keys"
        default 12
        range 1 32
        help
            Slots for remembered conditions, one per key (~128 bytes each,
            reserved for the life of the firmware). The set of conditions a
            firmware can raise is fixed at build time, so size this to what
            it actually raises; further keys are rejected with ESP_ERR_NO_MEM.
            espOS itself uses up to four: lowMemory, taskStalled, netDown and
            skLinkStalled.

    config ESPOS_HEALTH_MAX_SINKS
        int "Health sinks"
        default 4
        range 1 8
        help
            How many consumers may register for condition changes. espos_sk
            takes one when SignalK notifications are enabled; an application
            wanting a status LED or a line on a display takes another.

    menu "Watchdog policy"

        config ESPOS_HEALTH_POLICY_TICK_S
            int "Policy tick (seconds)"
            default 10
            range 1 60
            help
                How often the policy reads the heap, re-evaluates the built-in
                conditions and counts strikes. With the default strikes below,
                a fatal condition has to be held for tick × strikes = 30 s
                before the device restarts.

        config ESPOS_HEALTH_POLICY_STRIKES
            int "Consecutive fatal ticks before a restart"
            default 3
            range 1 10
            help
                A condition raised with ESPOS_HEALTH_F_REBOOT_ON_ALARM must be
                in ALARM on this many consecutive ticks for the device to
                restart; one tick without it resets the count. A warning or
                an ALARM without the flag never restarts anything.

        config ESPOS_HEALTH_HEAP_WARN_KB
            int "lowMemory: warn below total free heap (KB)"
            default 40
            range 0 4096
            help
                Warning only. 0 disables the check.

        config ESPOS_HEALTH_INTERNAL_WARN_KB
            int "lowMemory: warn below free internal RAM (KB)"
            default 20
            range 0 4096
            help
                Internal RAM is judged separately from the total because on a
                board with PSRAM it is the scarce pool: the radio, DMA and
                every task stack come from it, and tens of megabytes free
                overall can hide its exhaustion. Warning only; 0 disables.

        config ESPOS_HEALTH_INTERNAL_ALARM_KB
            int "lowMemory: fatal alarm below free internal RAM (KB)"
            default 12
            range 0 4096
            help
                Below this the device is about to lose the radio or a task
                stack, and a restart is the recovery. Held for the strike
                window it restarts the device. 0 disables.

                Sits below the deepest legitimate trough seen so far: an
                ESP32-P4 panel measured ~24 KB free / ~23 KB largest block
                while esp-sr's wake pipeline allocates at start, settling
                near 95 KB afterwards. A threshold above that trough would
                restart the panel on every boot.

        config ESPOS_HEALTH_LARGEST_BLOCK_ALARM_KB
            int "lowMemory: fatal alarm below largest free internal block (KB)"
            default 8
            range 0 4096
            help
                Fragmentation check: the free total can look fine while no
                single block is left for a socket buffer or a task stack.
                Same trough as above applies (~23 KB largest block seen). 0
                disables.

    endmenu

endmenu
```

## components/espos_httpd/Kconfig
```kconfig
menu "espOS HTTP server"

    config ESPOS_HTTPD_MAX_BODY
        int "Maximum request body size (bytes)"
        default 16384
        range 1024 262144
        help
            Requests with a larger Content-Length are rejected with 413.

    config ESPOS_HTTPD_STACK_SIZE
        int "Server task stack size (bytes)"
        default 8192
        range 4096 32768

    config ESPOS_HTTPD_TASK_PRIORITY
        int "Server task priority"
        default 5
        range 1 24

    config ESPOS_HTTPD_MAX_URI_HANDLERS
        int "Maximum number of URI handlers"
        default 64
        range 8 128

    config ESPOS_HTTPD_SSE_MAX_CLIENTS
        int "Maximum concurrent event-stream clients"
        default 3
        range 1 8
        help
            GET /api/v1/events keeps a socket open per client. The server's
            socket budget is 4 + this value, clamped to
            CONFIG_LWIP_MAX_SOCKETS - 3 (raise LWIP_MAX_SOCKETS for more).

    config ESPOS_HTTPD_SSE_MAX_CONNECT_CBS
        int "Maximum event-stream connect callbacks"
        default 8
        range 4 16
        help
            Each component that publishes to GET /api/v1/events registers one
            callback here, so a newly connected client gets the current state
            immediately instead of waiting for the next change. espOS itself
            ships six (net, wifi, sk, ota, ble, n2k); a firmware that adds its
            own needs room for those too.

            Running out is silent from the browser's side: the stream opens
            and every other component's snapshot arrives, so the one component
            that missed a slot looks merely idle rather than unregistered.

    config ESPOS_HTTPD_SSE_PING_S
        int "Event-stream keepalive interval (s)"
        default 15
        range 5 120

    config ESPOS_HTTPD_WWW_DIR
        string "Mount point of the UI storage partition"
        default "/www"
        help
            The LittleFS "storage" partition holding the gzipped UI bundle
            is mounted here and served at /.

    config ESPOS_HTTPD_DEBUG_CRASH
        bool "Expose POST /api/v1/system/crash (deliberate panic, for testing core dumps)"
        default n

    config ESPOS_HTTPD_AUTH_REQUIRED
        bool "Refuse protected endpoints until an API key is configured"
        default n
        help
            With an empty httpd.api_key the REST API is open to the network
            (the default, so a device that predates authentication keeps
            working after an update). A product build that must never ship
            open turns this on: protected endpoints then answer
            403 auth_unconfigured until a key is set. Requests from the
            setup portal's network are exempt, which is where the first key
            is set. See docs/security.md.

    config ESPOS_HTTPD_MAX_SESSIONS
        int "Maximum concurrent login sessions"
        default 4
        range 1 16
        help
            Cookie sessions minted by POST /api/v1/auth/login, kept in RAM
            (about 48 bytes each). One more login than this evicts the
            session idle longest; a reboot forgets them all. Bearer requests
            use no session.

    config ESPOS_HTTPD_TLS
        bool "Serve the device's own web UI and API over HTTPS (reserved)"
        default n
        help
            Reserved; not implemented. The device's web server is plain http
            because a TLS server on the smaller targets costs RAM the
            application needs, and a self-signed certificate on a boat LAN
            buys little (docs/security.md). Turning this on changes nothing
            yet; the option exists so a future implementation has a stable
            name.

endmenu
```

## components/espos_log/Kconfig
```kconfig
menu "espOS log ring"

    config ESPOS_LOG_RING_SIZE
        int "Log ring buffer size (bytes)"
        default 16384
        range 2048 262144
        help
            Recent log lines are kept in RAM for GET /api/v1/logs. Oldest
            lines are overwritten first.

    config ESPOS_LOG_LINE_MAX
        int "Longest stored line (bytes)"
        default 256
        range 64 1024
        help
            Longer lines are truncated when stored (console output is
            unaffected).

    config ESPOS_LOG_WALLCLOCK
        bool "Stamp stored lines with the wall clock once it is known"
        default y
        help
            The IDF log prefix carries milliseconds since boot, which is what
            you want for "how long after startup did this happen" and useless
            for lining a device's log up against a server's. With this on,
            once espos_time has a clock every line stored in the ring carries
            both — the monotonic value stays exactly where it was and the UTC
            time is added beside it:

                I (18452|2026-09-07T10:12:13.456Z) espos_sk: stream connected

            Lines logged before the clock is set are unchanged, so a boot log
            reads as it always did, and so is the console output: only what
            /api/v1/logs serves is stamped. A firmware built without
            espos_time keeps the monotonic-only prefix whatever this is set
            to, because there is no clock to ask.

endmenu
```
