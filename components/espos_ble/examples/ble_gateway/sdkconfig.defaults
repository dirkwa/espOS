## components/espos_ota/Kconfig
```kconfig
menu "espOS OTA"

    config ESPOS_OTA_MANIFEST_MAX
        int "Largest manifest accepted (bytes)"
        default 16384
        range 1024 65536
        help
            The version manifest (docs/ota.md) is fetched whole into RAM
            before it is parsed; a longer body fails the check. 16 KiB holds
            a manifest with dozens of builds. Raise it for a channel that
            lists every target of a long release history -- it costs that
            much heap only while a check runs.

    config ESPOS_OTA_BOOT_CHECK_DELAY_S
        int "First automatic manifest check after boot (s)"
        default 20
        range 0 3600
        help
            Uptime the automatic check waits for before its first fetch. It
            also waits for WiFi to be connected, so this is a settling time
            rather than a timeout: DHCP, mDNS and SignalK discovery all run
            in those first seconds, and a manifest fetch (or the install it
            may trigger) competing with them slows every one of them down.

    config ESPOS_OTA_NO_STA_GRACE_S
        int "Confirm a new image without a station config after (s)"
        default 60
        range 10 3600
        help
            A freshly installed image confirms itself once WiFi is connected.
            A device with no station configured (portal only) never gets
            there, so it is confirmed after this much uptime instead -- long
            enough that an image which crashes at boot has already been
            rolled back by the bootloader. Must be below ota.confirm_tmo_s,
            or the rollback timeout wins first.

    config ESPOS_OTA_STACK_SIZE
        int "OTA task stack size (bytes)"
        default 8192
        range 4096 32768
        help
            The task that fetches the manifest and runs esp_https_ota. TLS
            handshakes run on it, which is what the 8 KiB is for. The linux
            simulator sizes its task in words and ignores this.

endmenu
```

## components/espos_prov/Kconfig
```kconfig
menu "espOS BLE provisioning"

    config ESPOS_PROV
        bool "BLE provisioning (credentials from a phone, no access point)"
        default n
        depends on BT_BLUEDROID_ENABLED
        select ESP_PROTOCOMM_SUPPORT_SECURITY_VERSION_2
        help
            Lets a phone hand this device its WiFi credentials over BLE GATT
            instead of the setup access point.

            Off by default: it costs about 23 KB of flash and only makes sense
            on a device that has BLE at all. It needs Bluedroid; the
            application must already have brought the stack up (espos_ble does
            this, including the ESP32-P4's hosted co-processor path).

            NOTE this is built on protocomm directly, NOT on
            espressif/network_provisioning, because that component's manager
            drives the WiFi station itself and espOS's own state machine
            already owns those calls. The practical consequence is that
            Espressif's "ESP BLE Provisioning" phone app will NOT talk to this
            device -- it speaks the manager's protobuf schema. The endpoint
            here is plain JSON. See docs/provisioning.md.

            While provisioning is active BLE SCANNING IS SUSPENDED: Bluedroid
            keeps a single GAP callback and protocomm takes it, so a gateway
            left scanning would receive nothing at all and report no error.

    config ESPOS_PROV_TIMEOUT_S
        int "Stop advertising after this many seconds (0 = never)"
        default 600
        range 0 86400
        depends on ESPOS_PROV
        help
            A device left advertising for provisioning is a device anyone in
            range can try to configure. The default gives ten minutes to get
            a phone out, then closes the window.

endmenu
```

## components/espos_sensors/Kconfig
```kconfig
# SPDX-FileCopyrightText: 2026 Dirk Wahrheit
# SPDX-License-Identifier: Apache-2.0

menu "espOS sensors"

    config ESPOS_SENSORS_ONEWIRE
        bool "1-Wire and DS18B20 support"
        default n
        help
            Build espos_onewire.h: a 1-Wire bus and the DS18B20
            temperature sensors on it, over the registry components
            espressif/ds18b20 and espressif/onewire_bus.

            Off by default because turning it on downloads those two
            components and links the RMT driver they use. A firmware with
            no DS18B20 on it should pay for neither.

            The bus needs an external 4.7k pull-up to 3V3; the internal
            pull-up cannot supply a DS18B20 and the bus reads as empty.

    config ESPOS_SENSORS_MAX_GPIO_NODES
        int "GPIO change nodes"
        default 8
        range 1 32
        help
            How many GpioChange nodes can watch pins at once. Each holds
            the ISR trampoline that posts into the node's mailbox; the
            table is fixed so an interrupt never walks a list that
            something else is editing.

endmenu
```

## components/espos_sk/Kconfig
```kconfig
menu "espOS SignalK"

    config ESPOS_SK_RX_FRAME_MAX
        int "Largest inbound stream frame kept (bytes)"
        default 16384
        range 2048 131072
        help
            Delta messages larger than this are dropped (logged). A
            subscription burst after reconnect (values + meta for many
            paths) can reach several KiB; raise on PSRAM boards that
            subscribe to whole families.

    config ESPOS_SK_TLS
        bool "Talk to the server over TLS (https/wss)"
        default y
        select MBEDTLS_CERTIFICATE_BUNDLE
        help
            Compile the https/wss transports. Which scheme is actually used is
            the sk.scheme setting (auto/http/https, default auto), so a build
            with this on still talks plain http to a plain server.

            On by default since the trust store landed. Before it the only
            thing espOS could do with a certificate was check it against the
            bundled Mozilla roots, which refuses every boat server -- they are
            self-signed, or signed by a CA the owner made. That made the option
            close to useless and off was the honest default. Now the first
            connection pins what the server presents (sk.tls_trust, default
            "tofu") and holds it to that afterwards, the way ssh does, so
            turning it on is a decision about the network rather than about
            whether the server has a certificate a browser would like.

            Flash cost, measured on esp32c6, y minus n on the same tree:

              with espos_ota   about 10 KB (the reference app: 1485308 vs
                               1475280 bytes). mbedTLS and the certificate
                               bundle are already linked for the https image
                               source, so what is added here is the trust
                               store, the transports and the verify path.
              without espos_ota  about 78 KB (the tls_server example: 1437772
                               vs 1358004). Most of that is the Mozilla root
                               bundle, which the trust store still needs as a
                               fallback in bundle mode.

            RAM: roughly 20 KB while a connection is open, and
            ESPOS_SK_TLS_MIN_FREE_BLOCK_KB below refuses a handshake when that
            much contiguous internal RAM is not free.

            Turning it off drops the transports and mbedTLS with them; sk.scheme
            then reads as http whatever it is set to, and the device says so
            once at startup.

    config ESPOS_SK_TLS_CA_MAX
        int "Largest CA certificate accepted (bytes)"
        depends on ESPOS_SK_TLS
        default 2048
        range 512 8192
        help
            Cap on the PEM in sk.ca_pem and on PUT /api/v1/sk/tls/ca, and the
            size of the buffer holding it. A single RSA-4096 CA certificate in
            PEM is about 2 KB; raise this only for a chain, and remember it is
            RAM that stays allocated for the life of the device.

    config ESPOS_SK_TLS_MIN_FREE_BLOCK_KB
        int "Internal RAM needed before a TLS handshake (KB)"
        depends on ESPOS_SK_TLS
        default 24
        range 8 64
        help
            A handshake is refused, and retried after the usual backoff, unless
            this much *contiguous* internal RAM is free. Checked with
            heap_caps_get_largest_free_block(MALLOC_CAP_INTERNAL): total free
            heap is the wrong number on a PSRAM board, where tens of megabytes
            can hide the few kilobytes of internal RAM that actually matter.

            What it prevents is not a clean out-of-memory error. mbedTLS
            failing to allocate mid-handshake leaves a half-built session and a
            socket behind, and repeated on a reconnect loop it starves the WiFi
            stack of the same pool. Deferring is cheap, and the device raises a
            tlsMemory health condition so the reason is visible.

    config ESPOS_SK_TLS_HANDSHAKE_TIMEOUT_MS
        int "Wait for the one handshake slot (ms)"
        depends on ESPOS_SK_TLS
        default 10000
        range 1000 60000
        help
            Only one TLS handshake runs at a time on the device -- two at once
            is where the internal-RAM pool runs out, and the esp-tls attach
            hook carries no user pointer, so one at a time is also what makes
            the certificate-capture slot well defined. A caller that waits
            longer than this for the slot gives up and retries with its own
            backoff.

    config ESPOS_SK_HTTP_MAX_CONCURRENT
        int "Concurrent HTTP requests to the server"
        default 2
        range 1 8
        help
            Upper bound on espos_sk_http_* requests in flight at once --
            the token machine's and the meta reconciliation's own calls
            included. Each open request is a socket and, over TLS, roughly
            20 KB of RAM; a display that fetches one value per widget on a
            layout change would otherwise open dozens at the same moment.
            A caller over the limit waits up to its own timeout for a slot
            and gets ESP_ERR_TIMEOUT if none frees up.

    config ESPOS_SK_NOTIFICATIONS
        bool "Device-health notifications"
        default y
        help
            Publish espos_health conditions as SignalK notifications
            under notifications.espos.<label>.<key> -- memory pressure, a
            dependency that has gone away, whatever the application
            reports.

            Without them such a condition surfaces as a device that has
            quietly stopped working, which looks the same as a hardware
            fault and is the expensive kind of problem to diagnose.

            Turning it off drops the sink and the periodic low-memory
            check; conditions are still recorded by espos_health and still
            reach any other sink. The number of distinct conditions is
            ESPOS_HEALTH_MAX_CONDITIONS, under "espOS health".

endmenu
```

## components/espos_time/Kconfig
```kconfig
menu "espOS time"

    config ESPOS_TIME_RTC_STALE_H
        int "A time carried through deep sleep goes stale after (hours)"
        default 24
        range 0 8760
        help
            A device that naps between measurements keeps the wall clock in
            RTC memory and adopts it on waking, so it is not blind until the
            network comes back. That value drifts: the RTC oscillator is not
            a timekeeping crystal, and the sleep itself is only approximately
            measured. Past this age the device still reports the time — it is
            the best guess it has, and a log line with an approximate stamp
            beats one with none — but stops calling itself synced, so a
            consumer that needs a trustworthy timestamp can tell the
            difference.

            0 disables the rule and a restored time never goes stale.

    config ESPOS_TIME_MAX_SUBSCRIBERS
        int "Clock-change subscribers"
        default 4
        range 1 16
        help
            How many consumers may register with espos_time_subscribe() to be
            told when a source sets the clock. espOS itself takes one for the
            SignalK fallback (to stop it once NTP succeeds); an application
            wanting to redraw a display clock takes another. ~8 bytes each,
            reserved for the life of the firmware.

endmenu
```

## components/espos_voice/Kconfig
```kconfig
menu "espOS voice satellite"
    # esp-sr exists for these two targets only; everywhere else the component
    # is an empty stub (see CMakeLists.txt), so the knobs would be noise in
    # menuconfig. They keep their defaults regardless.
    visible if IDF_TARGET_ESP32S3 || IDF_TARGET_ESP32P4

    config ESPOS_VOICE_WYOMING_PORT
        int "Wyoming satellite TCP port"
        default 10700
        range 1 65535
        help
            Default listening port of WyomingSatellite
            (WyomingSatelliteConfig::port overrides it per instance). 10700
            is the port the reference wyoming-satellite uses and the one
            signalk-wyoming / Home Assistant dial unless told otherwise.

    config ESPOS_VOICE_SERVER_STACK_SIZE
        int "Satellite server task stack (bytes)"
        default 6144
        range 4096 16384
        help
            The task that accepts the orchestrator's connection, parses
            Wyoming events with cJSON and plays TTS through the AudioDriver.

    config ESPOS_VOICE_MIC_STACK_SIZE
        int "Mic streaming task stack (bytes)"
        default 4096
        range 2048 16384
        help
            Started per pipeline run to stream the mic to the orchestrator.
            It records into a heap buffer, so it needs little of its own.

    config ESPOS_VOICE_WAKE_STACK_SIZE
        int "Network wake task stack (bytes)"
        default 4608
        range 2048 16384
        help
            The outbound connection to a Wyoming wake service (openWakeWord)
            when the wake word is detected on the server rather than on the
            device. A little more than the mic task because it also parses
            the detection events it gets back.

    config ESPOS_VOICE_WAKENET_STACK_SIZE
        int "On-device wake (esp-sr) task stack (bytes)"
        default 4096
        range 2048 16384
        help
            Each of the two esp-sr tasks, feed and fetch. Fetch runs WakeNet
            inference, which is where the room goes; feed only copies mic
            frames into the AFE.

endmenu
```
