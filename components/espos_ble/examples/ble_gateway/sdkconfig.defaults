## components/espos_wifi/Kconfig
```kconfig
menu "espOS WiFi"

    config ESPOS_WIFI_MAX_NETWORKS
        int "Configured networks (priority slots)"
        default 4
        range 1 4
        help
            Number of ssidN/pskN/bssidN slots honoured from the "wifi"
            namespace (the descriptor declares four).

    config ESPOS_WIFI_MDNS
        bool "mDNS responder (<hostname>.local, _http._tcp, _espos._tcp)"
        default y
        depends on !IDF_TARGET_LINUX
        help
            Answer for <wifi.hostname>.local and advertise the web UI as
            _http._tcp and the device as _espos._tcp (TXT: app name and
            version, espOS version, chip, short id, API root). Applications
            register their own services with espos_mdns_add_service().

            This is how a device is found without knowing its address: a
            phone opens http://espos-1a2b.local, SignalK discovery browses
            for servers, a display client browses for players. Turning it
            off saves the responder task and its sockets (roughly 4 KB of
            RAM) and makes the device reachable by IP address only; SignalK
            discovery then cannot run and sk.server_host must be set.

            Not available on the linux target (no espressif/mdns there);
            the API compiles to stubs that report ESP_ERR_NOT_SUPPORTED.

    config ESPOS_WIFI_MDNS_MAX_SERVICES
        int "Application services (espos_mdns_add_service slots)"
        depends on ESPOS_WIFI_MDNS
        default 6
        range 1 16
        help
            Services an application may register on top of the two
            built-in ones; each slot holds one service type with its TXT
            record (up to 256 bytes) and is kept until the responder is
            up, so a service may be added before the network exists. A
            display with a player service and a control channel needs two.

            The responder has its own ceiling, CONFIG_MDNS_MAX_SERVICES
            (default 10): the two built-ins, these slots and any service a
            component registers with the responder directly (espos_n2k's
            candump server) all count against it.

endmenu
```

## main/Kconfig.projbuild
```kconfig
menu "espOS example app"

    menu "M1 network bootstrap (temporary, replaced by espos_wifi in M2)"

        config ESPOS_EXAMPLE_WIFI_SSID
            string "WiFi SSID"
            default ""
            help
                Station SSID used only so the M1 example can be reached over the
                network. Leave empty to skip WiFi entirely.

        config ESPOS_EXAMPLE_WIFI_PASSWORD
            string "WiFi password"
            default ""

    endmenu

endmenu
```

## test/host/espos_config_test/sdkconfig.defaults
```kconfig
CONFIG_IDF_TARGET="linux"
CONFIG_UNITY_ENABLE_IDF_TEST_RUNNER=y
CONFIG_PARTITION_TABLE_CUSTOM=y
CONFIG_PARTITION_TABLE_CUSTOM_FILENAME="partitions.csv"
CONFIG_PARTITION_TABLE_FILENAME="partitions.csv"
CONFIG_PARTITION_TABLE_OFFSET=0x8000
CONFIG_ESP_PARTITION_ERASE_CHECK=y
CONFIG_LOG_DEFAULT_LEVEL_WARN=y
CONFIG_ESPOS_CONFIG_MAX_MIGRATIONS=8
CONFIG_ESPOS_CONFIG_MAX_SUBSCRIBERS=4
```

## test/host/espos_log_test/sdkconfig.defaults
```kconfig
CONFIG_IDF_TARGET="linux"
CONFIG_UNITY_ENABLE_IDF_TEST_RUNNER=y
CONFIG_LOG_DEFAULT_LEVEL_INFO=y
CONFIG_ESPOS_LOG_RING_SIZE=2048
CONFIG_ESPOS_LOG_LINE_MAX=64
```
